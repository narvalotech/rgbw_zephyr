## .devcontainer/west.yml
```yaml
manifest:
  projects:
    - name: nrf
      url: https://github.com/nrfconnect/sdk-nrf
      revision: v1.5.1
      import:
        name-allowlist:
          - bsim
          - zephyr
          - nrfxlib
          - mcuboot
          - hal_nordic
```

## boards/arm/core840/Kconfig.board
```kconfig
# nRF52840 DK NRF52840 board configuration

# Copyright (c) 2016 Nordic Semiconductor ASA
# SPDX-License-Identifier: Apache-2.0

config BOARD_CORE840
	bool "nRF52840 m-watch core board"
	depends on SOC_NRF52840_QIAA
```

## boards/arm/core840/Kconfig.defconfig
```kconfig
# nRF52840 DK NRF52840 board configuration

# Copyright (c) 2016 Nordic Semiconductor ASA
# SPDX-License-Identifier: Apache-2.0

if BOARD_CORE840

config BOARD
	default "core840"

config BT_CTLR
	default BT

endif # BOARD_NRF52840DK_NRF52840
```
